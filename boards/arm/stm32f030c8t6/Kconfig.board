## boards/arm/stm32f030c8t6/Kconfig.board
```kconfig
# Copyright (c) 2022, TOKITA Hiroshi <tokita.hiroshi@gmail.com>
# SPDX-License-Identifier: Apache-2.0

config BOARD_STM32F030C8T6
	bool "ST STM32F030C8T6 Board"
	depends on SOC_STM32F030X8
```

## boards/arm/stm32f030c8t6/Kconfig.defconfig
```kconfig
# Copyright (c) 2022, TOKITA Hiroshi <tokita.hiroshi@gmail.com>
# SPDX-License-Identifier: Apache-2.0

if BOARD_STM32F030C8T6

config BOARD
	default "stm32f030c8t6"

endif # BOARD_STM32F030C8T6
```
